## app/hello_app/Kconfig
```kconfig
#
# For a description of the syntax of this configuration file,
# see the file kconfig-language.txt in the NuttX tools repository.
#

config LVX_USE_DEMO_CONTEST2026_087_HELLO_APP
	bool "Contest 2026 team 087 hello app (hardware validation)"
	default n
	---help---
		Enable the contest 2026 team 087 hello app demo.
		当前为设备硬件验证测试程序 (LCD/LED/按键/摄像头/加速度计/SD)。

config CONTEST2026_087_LCD_STUB
	bool "Use temporary LCD framebuffer backend"
	default n
	depends on LVX_USE_DEMO_CONTEST2026_087_HELLO_APP
	---help---
		Enable the in-memory LCD backend instead of the real /dev/fb0
		ST7789V driver (hardware/lcd_st7789.c).

config CONTEST2026_087_WIFI_STUB
	bool "Use temporary offline Wi-Fi backend"
	default y
	depends on LVX_USE_DEMO_CONTEST2026_087_HELLO_APP
	---help---
		Keep MiMo in local fallback mode until the Wi-Fi module is linked.

config CONTEST2026_087_BUTTON_STUB
	bool "Use mock button backend"
	default y
	depends on LVX_USE_DEMO_CONTEST2026_087_HELLO_APP
	---help---
		Enable the mock button sequence instead of the real GPIO button
		driver (hardware/buttons.c).

config CONTEST2026_087_CAMERA_STUB
	bool "Use mock camera backend"
	default y
	depends on LVX_USE_DEMO_CONTEST2026_087_HELLO_APP
	---help---
		Enable the mock camera backend instead of the real OV2640 driver
		(hardware/camera_ov2640.c).

config CONTEST2026_087_AUDIO_STUB
	bool "Use mock audio backend"
	default y
	depends on LVX_USE_DEMO_CONTEST2026_087_HELLO_APP
	---help---
		Enable the mock audio backend instead of the real I2S/buzzer
		driver (hardware/audio_i2s.c).
config CONTEST2026_087_PERCEPTION_MOCK
    bool "Perception mock mode"
    default y
    help
        Enable mock mode for perception module.
        If disabled, the module will call real MiMo cloud API for image recognition.
        Requires cJSON library when disabled.
config CONTEST2026_087_PERCEPTION_SERIAL
    bool "Perception over USB serial (bypass WiFi)"
    default n
    depends on LVX_USE_DEMO_CONTEST2026_087_HELLO_APP
    help
        Send captured JPEGs to a host PC over the USB serial link instead of
        over WiFi/HTTP.  The host runs tools/serial_bridge.py, performs the
        vision inference and writes the result back on the same serial line.
        This avoids the openvela ESP32-S3 SMP WiFi-TX crash triggered by large
        HTTP bodies.  Requires PERCEPTION_MOCK to be off.
```
